#include "Menu.h"
#include <AiEsp32RotaryEncoder.h>

#define ENCODER_CLK 25
#define ENCODER_DT  26
#define ENCODER_SW  27
#define ENCODER_VCC -1
#define ENCODER_STEPS 4

void displayMenu();
void rotary_loop();
void displaySubMenu();
void check_SubMenu();
void onButtonLongPress();
void onButtonShortPress();
void adjust_Brightness();
void setup_encoder();
void handle_rotary_button() ;
void graphic_weatherSystem();
void graphic_eyeRobot();
void graphic_languages();
void graphic_information();
void graphic_Brightness (); 
AiEsp32RotaryEncoder rotaryEncoder = AiEsp32RotaryEncoder(ENCODER_CLK, ENCODER_DT, ENCODER_SW, ENCODER_VCC, ENCODER_STEPS);

void IRAM_ATTR readEncoderISR() {
  rotaryEncoder.readEncoder_ISR();
}

//__________________End Setup Eye Robot__________________
int previousRotaryValue = 0;
int currentRotaryValue = 0;
unsigned long rotaryIdleStartTime = 0;
const unsigned long rotaryIdleDelay = 10000;
unsigned long longPressDelay = 1000;

/* Menu and submenu related variables */
int menuIndex_subMenu = 0;
int maxVisibleItems_Sub1 = 3;
int menuIndex = 0;
int numMenus = 5;
int maxVisibleItems = 4;
int numSubMenus[] = {3, 3, 3, 3, 3, 3}; // Number of submenus for each menu item
int currentBrightness = 128; // Độ sáng ban đầu (giá trị từ 0 đến 255)

bool inSubMenu = false;
bool inItemSubmenu_weather = false ;
bool inItemSubmenu_Robot = false;
bool inItemSubmenu_bright = false;
bool inItemSubmenu_languages = false;
bool inItemSubmenu_Infor = false;
String subMenus_Time[] = {"Display Time", "Settings", "Back to home"};
String subMenus_Robot[] = {"Happy Eye", "Scared", "Back to home"};
String subMenus_Infor[] = {"QR Code", "Map", "Back to home"};
String subMenus_Languages[] = {"Select Language", "Translate", "Back to home"};
String subMenus_Settings[] = {"Brightness", "WiFi", "Back to home"};

String* subMenus[] = {subMenus_Time, subMenus_Robot, subMenus_Infor, subMenus_Languages, subMenus_Settings};

String menus[] = {" Time", " Robot", " Information", " Languages", " Settings"};

//_________________________eye robot________________________________
static const unsigned char PROGMEM image_data_DISTRESSED_EYESarray[] = { 
  // ARRAY for DISTRESSED_EYES
  0x00, 0x00, 0x00, 0x00, 0x00, 0x00, 0x00, 0x00, 0x00, 0x00, 0x00, 0x00, 0x00, 0x00, 0x00, 0x00, 
  0x00, 0x00, 0x00, 0x00, 0x00, 0x00, 0x00, 0x00, 0x00, 0x00, 0x00, 0x00, 0x00, 0x00, 0x00, 0x00, 
  0x00, 0x00, 0x00, 0x00, 0x00, 0x00, 0x00, 0x00, 0x00, 0x00, 0x00, 0x00, 0x00, 0x00, 0x00, 0x00, 
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  0x00, 0x00, 0x00, 0x00, 0x00, 0x00, 0x00, 0x00, 0x00, 0x00, 0x00, 0x00, 0x00, 0x00, 0x00, 0x00,   
};

static const unsigned char PROGMEM image_data_EYES_FRONTarray[] = { 
  // ARRAY for 2nd Array EYES_FRONT 
  0x00, 0x00, 0x00, 0x00, 0x00, 0x00, 0x00, 0x00, 0x00, 0x00, 0x00, 0x00, 0x00, 0x00, 0x00, 0x00, 
  0x00, 0x00, 0x00, 0x00, 0x00, 0x00, 0x00, 0x00, 0x00, 0x00, 0x00, 0x00, 0x00, 0x00, 0x00, 0x00, 
  0x00, 0x00, 0x00, 0x00, 0x00, 0x00, 0x00, 0x00, 0x00, 0x00, 0x00, 0x00, 0x00, 0x00, 0x00, 0x00, 
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  0x00, 0x00, 0x00, 0x00, 0x00, 0x00, 0x00, 0x00, 0x00, 0x00, 0x00, 0x00, 0x00, 0x00, 0x00, 0x00, 
};

static const unsigned char PROGMEM image_data_EYES_RIGHTarray[] = { 
  // ARRAY for 3nd Array EYES_RIGHT
  0x00, 0x00, 0x00, 0x00, 0x00, 0x00, 0x00, 0x00, 0x00, 0x00, 0x00, 0x00, 0x00, 0x00, 0x00, 0x00, 
  0x00, 0x00, 0x00, 0x00, 0x00, 0x00, 0x00, 0x00, 0x00, 0x00, 0x00, 0x00, 0x00, 0x00, 0x00, 0x00, 
  0x00, 0x00, 0x00, 0x00, 0x00, 0x00, 0x00, 0x00, 0x00, 0x00, 0x00, 0x00, 0x00, 0x00, 0x00, 0x00, 
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  0x00, 0x00, 0x00, 0x00, 0x00, 0x00, 0x00, 0x00, 0x00, 0x00, 0x00, 0x00, 0x00, 0x00, 0x00, 0x00,    
};

//__________________________icon____________________________________- 
static const unsigned char PROGMEM image_display_contrast_bits[] = {0x07,0xc0,0x1c,0x30,0x33,0x08,0x6f,0x04,0x5f,0x04,0xdf,0x02,0xbf,0x02,0xbf,0x02,0xbf,0x02,0xdf,0x02,0x5f,0x04,0x6f,0x04,0x33,0x08,0x1c,0x30,0x07,0xc0,0x00,0x00};
static const unsigned char PROGMEM image_paint_0_bits[] = {0x7f,0xff,0xff,0xff,0xff,0xff,0xff,0xff,0xff,0x80,0x7f,0xff,0xff,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0x07,0x80};
static const unsigned char PROGMEM image_paint_1_bits[] = {0xff,0xff,0xff,0xff,0xff,0xf0,0xff,0xff,0xf8,0x00,0x00,0x00,0x00,0x1f,0xf0,0x00,0x00,0x00};
static const unsigned char PROGMEM image_battery_full_bits[] = {0x00,0x00,0x00,0x0f,0xff,0xfe,0x10,0x00,0x01,0x16,0xdb,0x6d,0x76,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0x00,0x00};
static const unsigned char PROGMEM image_battery_50_bits[] = {0x00,0x00,0x00,0x0f,0xff,0xfe,0x10,0x00,0x01,0x10,0x03,0x6d,0x70,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0x00,0x00};
static const unsigned char PROGMEM image_bluetooth_bits[] = {0x01,0x00,0x02,0x80,0x02,0x40,0x22,0x20,0x12,0x20,0x0a,0x40,0x06,0x80,0x03,0x00,0x06,0x80,0x0a,0x40,0x12,0x20,0x22,0x20,0x02,0x40,0x02,0x80,0x01,0x00,0x00,0x00};
static const unsigned char PROGMEM image_phone_contacts_bits[] = {0x07,0x00,0x08,0x80,0x10,0x40,0x10,0x40,0x10,0x40,0x08,0x80,0x07,0x00,0x00,0x00,0x0f,0x80,0x30,0x60,0x40,0x10,0x40,0x10,0x80,0x08,0x80,0x08,0x80,0x08,0xff,0xf8};
//__________________________SCROLLBAR_________________________
#define SCROLLBAR_HEIGHT 64 // Chiều cao thanh cuộn phù hợp với chiều cao màn hình
#define SCROLLBAR_WIDTH 5
#define SCROLLBAR_X 122
#define SCROLLBAR_Y 0
#define SCROLLBAR_INNER_X 124
#define SCROLLBAR_INNER_WIDTH 2

static const unsigned char PROGMEM image_date_day_bits[] = {0x00,0x00,0x09,0x20,0x7f,0xfc,0xc9,0x26,0x80,0x02,0x8c,0x22,0x92,0x62,0x92,0xa2,0x82,0x22,0x84,0x22,0x88,0x22,0x90,0x22,0x9e,0xf2,0xc0,0x06,0x7f,0xfc,0x00,0x00};
//icon setting
static const unsigned char PROGMEM image_menu_settings_gear_bits[] = {0x03,0xc0,0x12,0x48,0x2c,0x34,0x40,0x02,0x23,0xc4,0x24,0x24,0xc8,0x13,0x88,0x11,0x88,0x11,0xc8,0x13,0x24,0x24,0x23,0xc4,0x40,0x02,0x2c,0x34,0x12,0x48,0x03,0xc0};
//icon languages
static const unsigned char PROGMEM image_network_www_bits[] = {0x03,0xc0,0x0d,0xb0,0x32,0x4c,0x24,0x24,0x44,0x22,0x7f,0xfe,0x88,0x11,0x88,0x11,0x88,0x11,0x88,0x11,0x7f,0xfe,0x44,0x22,0x24,0x24,0x32,0x4c,0x0d,0xb0,0x03,0xc0};

const unsigned char bitmap_icon_dashboard [] PROGMEM = {
  0x07, 0xe0, 0x18, 0x18, 0x21, 0x24, 0x50, 0x02, 0x48, 0x0a, 0x84, 0x01, 0x83, 0x81, 0xa2, 0x45, 
  0x82, 0x41, 0x81, 0x81, 0xa0, 0x05, 0x40, 0x02, 0x4b, 0xd2, 0x23, 0xc4, 0x18, 0x18, 0x07, 0xe0
};
//icon Robot
const unsigned char bitmap_icon_robot [] PROGMEM = {
  0x3c, 0x3c, 0x42, 0x42, 0x81, 0x81, 0x99, 0x81, 0xa5, 0x99, 0x81, 0x81, 0x81, 0x42, 0x42, 0x3c
};

void setup_encoder()
{
  rotaryEncoder.begin();
  rotaryEncoder.setup(readEncoderISR);
  rotaryEncoder.setBoundaries(-99999, 99999, true);
  rotaryEncoder.disableAcceleration(); 
}
void displayMenu() {
  display.clearDisplay();
  display.setTextSize(1);
  display.setTextColor(SH110X_WHITE);
  display.setCursor(0, 0);

  int startIndex = menuIndex > 0 ? menuIndex - 1 : 0;
  int endIndex = menuIndex + 2 < numMenus ? menuIndex + 2 : numMenus - 1;

  float percentVisible = (float)(endIndex - startIndex + 1) / numMenus;
  int scrollbarInnerHeight = SCROLLBAR_HEIGHT * percentVisible;

  display.drawRoundRect(SCROLLBAR_X, SCROLLBAR_Y, SCROLLBAR_WIDTH, SCROLLBAR_HEIGHT, 1, SH110X_WHITE);

  int scrollbarPosition = map(startIndex, 0, numMenus - (endIndex - startIndex + 1), SCROLLBAR_Y, SCROLLBAR_Y + SCROLLBAR_HEIGHT - scrollbarInnerHeight);

  display.fillRect(SCROLLBAR_INNER_X, scrollbarPosition, SCROLLBAR_INNER_WIDTH, scrollbarInnerHeight, SH110X_WHITE);

  for (int i = startIndex; i <= endIndex; i++) {
    if (i == menuIndex) {
      display.drawRoundRect(0, (i - startIndex) * 20 + 10, 128, 20, 3, SH110X_WHITE);
    }

    if (menus[i] == " Time") {
      display.drawBitmap(0, (i - startIndex) * 20 + 12, image_date_day_bits, 16, 16, SH110X_WHITE);
      display.setCursor(20, (i - startIndex) * 20 + 16);
    } else if (menus[i] == " Robot") {
      display.drawBitmap(0, (i - startIndex) * 20 + 12, bitmap_icon_robot, 16, 16, SH110X_WHITE);
      display.setCursor(20, (i - startIndex) * 20 + 16);
    } else if (menus[i] == " Information") {
      display.drawBitmap(0, (i - startIndex) * 20 + 12, image_phone_contacts_bits, 16, 16, SH110X_WHITE);
      display.setCursor(20, (i - startIndex) * 20 + 16);
    } else if (menus[i] == " Settings") {
      display.drawBitmap(0, (i - startIndex) * 20 + 12, image_menu_settings_gear_bits, 16, 16, SH110X_WHITE);
      display.setCursor(20, (i - startIndex) * 20 + 16);
    } else if (menus[i] == " Languages") {
      display.drawBitmap(0, (i - startIndex) * 20 + 12, image_network_www_bits, 16, 16, SH110X_WHITE);
      display.setCursor(20, (i - startIndex) * 20 + 16);
    } else {
      display.setCursor(4, (i - startIndex) * 20 + 16);
    }
    display.print(menus[i]);
  }
  display.display();
}

void rotary_loop() {
  if (rotaryEncoder.encoderChanged()) {
    currentRotaryValue = rotaryEncoder.readEncoder();

    if (inSubMenu) {
      if (currentRotaryValue > previousRotaryValue) {
        if (menuIndex_subMenu < numSubMenus[menuIndex] - 1) {
          menuIndex_subMenu++;
        } else {
          menuIndex_subMenu = 0;
        }
      } else {
        if (menuIndex_subMenu > 0) {
          menuIndex_subMenu--;
        } else {
          menuIndex_subMenu = numSubMenus[menuIndex] - 1;
        }
      }
    } else {
      if (currentRotaryValue > previousRotaryValue) {
        if (menuIndex < numMenus - 1) {
          menuIndex++;
        } else {
          menuIndex = 0;
        }
      } else {
        if (menuIndex > 0) {
          menuIndex--;
        } else {
          menuIndex = numMenus - 1;
        }
      }
    }
    previousRotaryValue = currentRotaryValue;
    rotaryIdleStartTime = millis();
  }
}

void displaySubMenu() {
  display.clearDisplay();
  display.setTextSize(1);
  display.setTextColor(SH110X_WHITE);
  display.setCursor(0, 0);

  int startIndex_Sub1 = menuIndex_subMenu > 0 ? menuIndex_subMenu - 1 : 0;
  int endIndex_Sub1 = menuIndex_subMenu + 2 < numSubMenus[menuIndex] ? menuIndex_subMenu + 2 : numSubMenus[menuIndex] - 1;

  float percentVisible = (float)(endIndex_Sub1 - startIndex_Sub1 + 1) / numSubMenus[menuIndex];
  int scrollbarInnerHeight = SCROLLBAR_HEIGHT * percentVisible;

  display.drawRoundRect(SCROLLBAR_X, SCROLLBAR_Y, SCROLLBAR_WIDTH, SCROLLBAR_HEIGHT, 1, SH110X_WHITE);

  int scrollbarPosition = map(startIndex_Sub1, 0, numSubMenus[menuIndex] - (endIndex_Sub1 - startIndex_Sub1 + 1), SCROLLBAR_Y, SCROLLBAR_Y + SCROLLBAR_HEIGHT - scrollbarInnerHeight);

  display.fillRect(SCROLLBAR_INNER_X, scrollbarPosition, SCROLLBAR_INNER_WIDTH, scrollbarInnerHeight, SH110X_WHITE);

  for (int i = startIndex_Sub1; i <= endIndex_Sub1; i++) {
    if (i == menuIndex_subMenu) {
      display.drawRoundRect(0, (i - startIndex_Sub1) * 12 + 12, 120, 11, 3, SH110X_WHITE);
    }
    display.setCursor(4, (i - startIndex_Sub1) * 12 + 14);
    display.print(subMenus[menuIndex][i]);
  }
  display.display();
}
void onButtonShortPress() {
  if (inSubMenu) {
    if (subMenus[menuIndex][menuIndex_subMenu] == "Back to home") {
      inSubMenu = false;
      inItemSubmenu_Robot = false;
      inItemSubmenu_weather = false;
      inItemSubmenu_bright = false;
      inItemSubmenu_Infor = false;
    } 
    if(subMenus[menuIndex][menuIndex_subMenu] == "Display Time")
    {
      inItemSubmenu_weather = true;
      inSubMenu = false;
      inItemSubmenu_Robot = false;
      inItemSubmenu_bright = false;
      inItemSubmenu_Infor = false;
    }
    if(subMenus[menuIndex][menuIndex_subMenu] == "Happy Eye")
    {
      inItemSubmenu_weather = false;
      inSubMenu = false;
      inItemSubmenu_Robot = true;
      inItemSubmenu_bright = false;
      inItemSubmenu_Infor = false;
    }
    if(subMenus[menuIndex][menuIndex_subMenu] == "Brightness")
    {
      int check_bright;
      inItemSubmenu_weather = false;
      inSubMenu = false;
      inItemSubmenu_Robot = false;
      inItemSubmenu_bright = true;
      inItemSubmenu_Infor = false;
      Serial.print("Access to the Brightness");
      adjust_Brightness();
    }
    if (subMenus[menuIndex][menuIndex_subMenu] == "Select Language")
    {
      inItemSubmenu_weather =false;
      inSubMenu = false;
      inItemSubmenu_Robot = false;
      inItemSubmenu_bright = false;
      inItemSubmenu_languages = true;
      inItemSubmenu_Infor = false;
      Serial.print("Access to the Languages");
    }
    if(subMenus[menuIndex][menuIndex_subMenu] == "QR Code")
    {
      inItemSubmenu_weather =false;
      inSubMenu = false;
      inItemSubmenu_Robot = false;
      inItemSubmenu_bright = false;
      inItemSubmenu_languages = false;
      inItemSubmenu_Infor = true;
    }
  }else{
  inSubMenu = true;
  inItemSubmenu_weather =false;
  inItemSubmenu_Robot = false;
  inItemSubmenu_bright = false;
  inItemSubmenu_languages = false;
  inItemSubmenu_Infor = false;
  menuIndex_subMenu = 0;
  displaySubMenu();
  }
}

//___________________________Adjust Brightness________________--
void adjust_Brightness() {
  // Tăng độ sáng
  currentBrightness += 25;
  if (currentBrightness > 255) {
    currentBrightness = 0;
  }
  // display.ssd1306_command(SSD1306_SETCONTRAST);
  // display.ssd1306_command(currentBrightness);
}

void handle_rotary_button() {
  static unsigned long buttonPressedTime = 0;
  static bool isLongpress = false;
  bool isEncoderButtonDown = rotaryEncoder.isEncoderButtonDown();

  if (isEncoderButtonDown) {
    if (!buttonPressedTime) {
      buttonPressedTime = millis();
    }

    if (!isLongpress && (millis() - buttonPressedTime >= longPressDelay)) {
      onButtonLongPress();
      isLongpress = true;
      rotaryIdleStartTime = millis();
    }
  } else {
    if (buttonPressedTime) {
      if (!isLongpress) {
        onButtonShortPress();
        rotaryIdleStartTime = millis();
      }
      buttonPressedTime = 0;
      isLongpress = false;
    }
  }
}

void graphic_weatherSystem() {
  display.clearDisplay();
  struct tm timeinfo;
  if (!getLocalTime(&timeinfo)) {
    Serial.println("Failed to obtain time");
    return;
  }
  // Print the current time to the serial monitor
  Serial.println(&timeinfo, "Time: %A, %B %d %Y %H:%M:%S");
  // Draw other weather system information
  //display.setTextColor(SH110X_WHITE);
  display.drawBitmap(162, 74, image_battery_50_bits, 24, 16, SH110X_WHITE);
  display.drawBitmap(140, 74, image_bluetooth_bits, 14, 16, SH110X_WHITE);
  display.drawLine(0, 17, 128, 17, SH110X_WHITE);
  display.setCursor(4, 6);
  display.print("Working Time");
  display.setCursor(5, 22);
  display.print(&timeinfo, "Date: %A");
  display.setCursor(29, 36);
  display.print(&timeinfo, "  %B %d  %Y ");
  display.drawBitmap(101, 1, image_battery_full_bits, 24, 16, SH110X_WHITE);
  display.setCursor(5, 50);
  display.print(&timeinfo, "Time: %H:%M:%S");
  display.drawBitmap(85, 1, image_bluetooth_bits, 14, 16, SH110X_WHITE);

  // Update the display with the drawn graphics
  display.display();
}

//_____________________Function : Eye Robot__________________
bool eyeDisplayed = false;
unsigned long lastEyeUpdateTime = 0;
const unsigned long eyeUpdateInterval = 1000; // 2 giây

void graphic_eyeRobot() {
  unsigned long currentTime = millis();

  if (currentTime - lastEyeUpdateTime > eyeUpdateInterval) {
    display.clearDisplay(); // Chỉ xóa màn hình khi cần thiết
    if (eyeDisplayed) {
      Serial.println("Display Eye Right");
      display.drawBitmap(0, 0, image_data_EYES_RIGHTarray, 128, 64, 1);
      eyeDisplayed = false;
    } else {
      Serial.println("Display Eye Front");
      display.drawBitmap(0, 0, image_data_EYES_FRONTarray, 128, 64, 1);
      eyeDisplayed = true;
    }
    display.display();
    lastEyeUpdateTime = currentTime;
  }
}

void graphic_Brightness () {
  display.clearDisplay();
  display.setTextColor(1);
  display.drawBitmap(162, 74, image_battery_50_bits, 24, 16, 1);
  display.drawBitmap(5, 11, image_display_contrast_bits, 15, 16, 1);
  display.drawBitmap(140, 74, image_bluetooth_bits, 14, 16, 1);
  display.drawLine(0, 0, 0, 0, 1);
  display.drawLine(19, 34, 19, 51, 1);
  display.drawLine(20, 51, 113, 51, 1);
  display.drawLine(113, 50, 113, 35, 1);
  display.drawLine(113, 34, 19, 34, 1);
  display.drawPixel(87, 18, 1);
  display.drawPixel(87, 23, 1);
  display.setCursor(24, 16);
  display.print("Brightness");
  display.setCursor(93, 17);
  display.print("60 %");
  display.drawLine(21, 37, 21, 48, 1);
  display.drawLine(21, 37, 93, 37, 1);
  display.drawLine(21, 49, 92, 49, 1);
  display.drawLine(93, 37, 93, 49, 1);
  display.drawBitmap(21, 37, image_paint_0_bits, 73, 12, 1);
  display.drawBitmap(22, 48, image_paint_1_bits, 69, 2, 1);
  display.display();
}

void graphic_languages() {
  display.clearDisplay();
  display.setTextColor(1);
  display.drawBitmap(162, 74, image_battery_50_bits, 24, 16, 1);
  display.drawBitmap(140, 74, image_bluetooth_bits, 14, 16, 1);
  display.drawBitmap(100, 7, image_network_www_bits, 16, 16, 1);
  display.setCursor(36, 14);
  display.print("Languages");
  display.drawLine(0, 0, 0, 0, 1);
  display.drawBitmap(10, 7, image_phone_contacts_bits, 13, 16, 1);
  display.drawLine(0, 26, 127, 26, 1);  
  display.setCursor(14, 35);
  display.setCursor(14, 35);
  display.print("Current Language");
  display.setCursor(31, 50);
  display.print("Vietnamese");
  display.display();
}
void graphic_information() {
  display.clearDisplay();
  const unsigned char myBitmap [] PROGMEM = {
	0xff, 0xff, 0xff, 0xff, 0xff, 0xff, 0xff, 0xff, 0xff, 0xff, 0xff, 0xff, 0xff, 0xff, 0xff, 0xff, 
	0xff, 0xff, 0xff, 0xff, 0xff, 0xff, 0xff, 0xff, 0xff, 0xff, 0xff, 0xff, 0xff, 0xff, 0xff, 0xff, 
	0xff, 0xff, 0xff, 0xff, 0xff, 0xff, 0xff, 0xff, 0xff, 0xff, 0xff, 0xff, 0xff, 0xff, 0xff, 0xff, 
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	0xff, 0xff, 0xff, 0xff, 0xff, 0xff, 0xff, 0xff, 0xff, 0xff, 0xff, 0xff, 0xff, 0xff, 0xff, 0xff
};
  display.drawBitmap(0, 0, myBitmap, 128, 64, 1);
  display.display();
}
void check_SubMenu()
{
  if (inSubMenu) {
    displaySubMenu();
  } else if (inItemSubmenu_weather) {
    graphic_weatherSystem();
  } else if (inItemSubmenu_Robot) {
    graphic_eyeRobot();
  } else if(inItemSubmenu_bright) {
    graphic_Brightness();
    adjust_Brightness();
  } else if(inItemSubmenu_languages) {
    graphic_languages();
  } else if(inItemSubmenu_Infor) {
    graphic_information();
  }
  else {
    displayMenu();
  }
}
void onButtonLongPress() {
  // Implement long press action if needed
}
